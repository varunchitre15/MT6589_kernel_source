## kernel/drivers/nfc/Kconfig
```kconfig
#
# Near Field Communication (NFC) devices
#

menu "Near Field Communication (NFC) devices"
    depends on MTK_NFC

config PN544_NFC
	tristate "PN544 NFC driver"
	depends on I2C
	select CRC_CCITT
	default n
	---help---
	  Say yes if you want PN544 Near Field Communication driver.
	  This is for i2c connected version. If unsure, say N here.

	  To compile this driver as a module, choose m here. The module will
	  be called pn544.

config NFC_PN533
	tristate "NXP PN533 USB driver"
	depends on USB
    default n
	---help---
	  NXP PN533 USB driver.
	  This driver provides support for NFC NXP PN533 devices.

	  Say Y here to compile support for PN533 devices into the
	  kernel or say M to compile it as module (pn533).

config NFC_WILINK
	tristate "Texas Instruments NFC WiLink driver"
	depends on TI_ST && NFC_NCI
    default n
	---help---
	  This enables the NFC driver for Texas Instrument's BT/FM/GPS/NFC
	  combo devices. This makes use of shared transport line discipline
	  core driver to communicate with the NFC core of the combo chip.

	  Say Y here to compile support for Texas Instrument's NFC WiLink driver
	  into the kernel or say M to compile it as module.

config NFC_MSR3110
	tristate "MSR3110 NFC driver"
	default n
	---help---
	MSR3110 NFC support.

config NFC_MT6605
	tristate "MT6605 NFC driver"
	default n
	---help---
	MT6605 NFC support.


endmenu
```

## mediatek/kernel/Kconfig
```kconfig
menuconfig MEDIATEK_SOLUTION
        bool "MediaTek Properitary Configuration"
        help
            Check this to enable MediaTek properity configuration.

if MEDIATEK_SOLUTION

choice 
    bool "System Type"

config ARCH_MT6516
        bool "MediaTek MT6516"
        select GENERIC_TIME
        select GENERIC_CLOCKEVENTS
        select CPU_ARM926T
        help
          This enable support for MediaTek MT6516.

config ARCH_MT6573
        bool "MediaTek MT6573"
        select GENERIC_TIME
        select GENERIC_CLOCKEVENTS
        select ARCH_HAS_CPUFREQ
        select CPU_V6
        help
          This enable support for MediaTek MT6573.

config ARCH_MT6575
        bool "MediaTek MT6575"
        select GENERIC_TIME
        select GENERIC_CLOCKEVENTS
        select ARCH_HAS_CPUFREQ
        select ARM_AMBA
        select CPU_V7
        select ARM_GIC
        select NEED_MACH_MEMORY_H
        select MIGHT_HAVE_CACHE_L2X0
        help
          This enable support for MediaTek MT6575.

config ARCH_MT6577
        bool "MediaTek MT6577"
        select GENERIC_TIME
        select GENERIC_CLOCKEVENTS
        select ARCH_HAS_CPUFREQ
        select ARM_AMBA
        select HAVE_SMP
        select CPU_V7
        select NEED_MACH_MEMORY_H
        select MIGHT_HAVE_CACHE_L2X0
        select ARM_GIC
        help
          This enable support for MediaTek MT6577.

config ARCH_MT8320
        bool "MediaTek MT8320"
        select GENERIC_TIME
        select GENERIC_CLOCKEVENTS
        select ARCH_HAS_CPUFREQ
        select ARM_AMBA
        select CPU_V7
        help

config ARCH_MT6589
        bool "MediaTek MT6589"
        select GENERIC_TIME
        select GENERIC_CLOCKEVENTS
        select ARCH_HAS_CPUFREQ
        select ARM_AMBA
        select CPU_V7
        select HAVE_SMP
        select NEED_MACH_MEMORY_H
        select ARM_GIC
        help
          This enable support for MediaTek MT6589.

endchoice


if ARCH_MT6589
source "../mediatek/platform/mt6589/kernel/Kconfig/Kernel"
source "../mediatek/platform/mt6589/kernel/Kconfig/Board"
source "../mediatek/platform/mt6589/kernel/Kconfig/Drivers"
endif

endif
```
